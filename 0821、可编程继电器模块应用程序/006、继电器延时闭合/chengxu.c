/********************************************************************
                            汇诚科技

实现功能:继电器延时闭合
使用芯片：STC15F104E
晶振：12MHZ
编译环境：Keil
作者：zhangxinchunleo
网站：www.ourhc.cn
淘宝店：汇诚科技 http://shop36330473.taobao.com
【声明】此程序仅用于学习与参考，引用请注明版权和作者信息！     

*********************************************************************/
/********************************************************************/
#include "reg52.h" 
#include <intrins.H>
#define uchar unsigned char 
#define uint  unsigned int
/********************************************************************
                            初始定义
*********************************************************************/ 
sbit  P33=P3^3; 
/********************************************************************
                            延时100MS函数
*********************************************************************/

void Delay100ms()		//12.000MHz
{
	uchar i, j, k;
	_nop_();
	i = 5;
	j = 144;
	k = 71;
	do
	{
		do
		{
			while (--k);
		} while (--j);
	} while (--i);
}
/********************************************************************
                            延时1S函数
*********************************************************************/
void Delay1s(uint s)		//12.000MHz
{
 uchar m,n;
for(m=s;m>0;m--)
for(n=10;n>0;n--)
Delay100ms();
}

/********************************************************************
                            主函数义
*********************************************************************/
void main() 
{
 for(;;) 
 {
P33=0;
Delay1s(2);	  //延时2秒
P33=1;  //取反 P3.3
while(1)
{
}
 } 
}
/********************************************************************
                            结束函数
*********************************************************************/
