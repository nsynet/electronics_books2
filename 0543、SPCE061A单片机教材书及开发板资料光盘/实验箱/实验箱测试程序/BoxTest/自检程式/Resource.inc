
// Resource Table
// Created by IDE, Do not modify this table

.TEXT
.external _RES_Table;
.external _RES_1_48K_SA;
.external _RES_1_48K_EA;
.external _RES_2_48K_SA;
.external _RES_2_48K_EA;
.external _RES_3_48K_SA;
.external _RES_3_48K_EA;
.external _RES_4_48K_SA;
.external _RES_4_48K_EA;
.external _RES_5_48K_SA;
.external _RES_5_48K_EA;
.external _RES_6_48K_SA;
.external _RES_6_48K_EA;
.external _RES_7_48K_SA;
.external _RES_7_48K_EA;
.external _RES_8_48K_SA;
.external _RES_8_48K_EA;
.external _RES_9_48K_SA;
.external _RES_9_48K_EA;
.external _RES_10_48K_SA;
.external _RES_10_48K_EA;
.external _RES_11_48K_SA;
.external _RES_11_48K_EA;
.external _RES_12_48K_SA;
.external _RES_12_48K_EA;
.external _RES_13_48K_SA;
.external _RES_13_48K_EA;
.external _RES_14_48K_SA;
.external _RES_14_48K_EA;
.external _RES_15_48K_SA;
.external _RES_15_48K_EA;
.external _RES_01_48K_SA;
.external _RES_01_48K_EA;
.external _RES_16_48K_SA;
.external _RES_16_48K_EA;
.external _RES_08_48K_SA;
.external _RES_08_48K_EA;

// End Table
