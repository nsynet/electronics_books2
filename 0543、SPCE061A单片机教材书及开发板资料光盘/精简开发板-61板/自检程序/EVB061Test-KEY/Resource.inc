
// Resource Table
// Created by IDE, Do not modify this table

.TEXT
.external _RES_Table;
.external _RES_09_48K_SA;
.external _RES_09_48K_EA;
.external _RES_02_48K_SA;
.external _RES_02_48K_EA;
.external _RES_03_48K_SA;
.external _RES_03_48K_EA;
.external _RES_04_48K_SA;
.external _RES_04_48K_EA;
.external _RES_05_48K_SA;
.external _RES_05_48K_EA;
.external _RES_06_48K_SA;
.external _RES_06_48K_EA;
.external _RES_07_48K_SA;
.external _RES_07_48K_EA;
.external _RES_08_48K_SA;
.external _RES_08_48K_EA;
.external _RES_01_48K_SA;
.external _RES_01_48K_EA;
.external _RES_12_48K_SA;
.external _RES_12_48K_EA;
.external _RES_11_48K_SA;
.external _RES_11_48K_EA;
.external _RES_10_48K_SA;
.external _RES_10_48K_EA;

// End Table
