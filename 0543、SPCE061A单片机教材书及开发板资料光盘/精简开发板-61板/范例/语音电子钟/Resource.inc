
// Resource Table
// Created by IDE, Do not modify this table

.TEXT
.external _RES_Table;
.external _RES_T040_16K_SA;
.external _RES_T040_16K_EA;
.external _RES_T041_16K_SA;
.external _RES_T041_16K_EA;
.external _RES_T042_16K_SA;
.external _RES_T042_16K_EA;
.external _RES_T043_16K_SA;
.external _RES_T043_16K_EA;
.external _RES_T044_16K_SA;
.external _RES_T044_16K_EA;
.external _RES_T045_16K_SA;
.external _RES_T045_16K_EA;
.external _RES_T046_16K_SA;
.external _RES_T046_16K_EA;
.external _RES_T047_16K_SA;
.external _RES_T047_16K_EA;
.external _RES_T048_16K_SA;
.external _RES_T048_16K_EA;
.external _RES_T049_16K_SA;
.external _RES_T049_16K_EA;
.external _RES_T050_16K_SA;
.external _RES_T050_16K_EA;
.external _RES_T051_16K_SA;
.external _RES_T051_16K_EA;
.external _RES_T052_16K_SA;
.external _RES_T052_16K_EA;
.external _RES_T053_16K_SA;
.external _RES_T053_16K_EA;
.external _RES_T054_16K_SA;
.external _RES_T054_16K_EA;
.external _RES_T055_16K_SA;
.external _RES_T055_16K_EA;
.external _RES_T056_16K_SA;
.external _RES_T056_16K_EA;
.external _RES_T057_16K_SA;
.external _RES_T057_16K_EA;
.external _RES_T058_16K_SA;
.external _RES_T058_16K_EA;
.external _RES_T059_16K_SA;
.external _RES_T059_16K_EA;
.external _RES_T060_16K_SA;
.external _RES_T060_16K_EA;
.external _RES_T061_16K_SA;
.external _RES_T061_16K_EA;
.external _RES_T062_16K_SA;
.external _RES_T062_16K_EA;
.external _RES_T063_16K_SA;
.external _RES_T063_16K_EA;
.external _RES_T064_16K_SA;
.external _RES_T064_16K_EA;
.external _RES_T065_16K_SA;
.external _RES_T065_16K_EA;
.external _RES_T066_16K_SA;
.external _RES_T066_16K_EA;

// End Table
